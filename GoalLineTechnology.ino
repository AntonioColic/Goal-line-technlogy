#include <SPI.h>
#include <Wire.h>
#include <Adafruit_GFX.h>
#include <Adafruit_SSD1306.h>

#define SCREEN_WIDTH 128 
#define SCREEN_HEIGHT 32 


#define OLED_RESET 4
Adafruit_SSD1306 display(SCREEN_WIDTH, SCREEN_HEIGHT, &Wire, OLED_RESET);

// '0002', 128x32px
const unsigned char myBitmap1 [] PROGMEM = {
  0x00, 0x00, 0x00, 0x03, 0xff, 0xff, 0xff, 0xc0, 0x00, 0x00, 0x00, 0x00, 0x00, 0x00, 0x00, 0x00, 
  0x00, 0x00, 0x00, 0x03, 0xff, 0xff, 0xef, 0xff, 0xf8, 0x00, 0x00, 0x00, 0x00, 0x00, 0x00, 0x00, 
  0x00, 0x00, 0x00, 0x03, 0x81, 0xf7, 0xff, 0xff, 0xbf, 0xfe, 0x80, 0x00, 0x00, 0x00, 0x00, 0x00, 
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  0x00, 0x00, 0x00, 0x00, 0x00, 0x00, 0x0f, 0x80, 0x00, 0x00, 0x00, 0x00, 0x00, 0x00, 0x00, 0x00
};
// '0003', 128x32px
const unsigned char myBitmap2 [] PROGMEM = {
  0x00, 0x00, 0x00, 0x03, 0xff, 0xff, 0xff, 0xc0, 0x00, 0x00, 0x00, 0x00, 0x00, 0x00, 0x00, 0x00, 
  0x00, 0x00, 0x00, 0x03, 0xff, 0xff, 0xef, 0xff, 0xf8, 0x00, 0x00, 0x00, 0x00, 0x00, 0x00, 0x00, 
  0x00, 0x00, 0x00, 0x03, 0x81, 0xf7, 0xff, 0xff, 0xbf, 0xff, 0x80, 0x00, 0x00, 0x00, 0x00, 0x00, 
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  0x00, 0x00, 0x00, 0x00, 0x00, 0x00, 0x0f, 0x80, 0x00, 0x00, 0x00, 0x00, 0x00, 0x00, 0x00, 0x00
};
// '0004', 128x32px
const unsigned char myBitmap3 [] PROGMEM = {
  0x00, 0x00, 0x00, 0x03, 0xff, 0xff, 0xff, 0xc0, 0x00, 0x00, 0x00, 0x00, 0x00, 0x00, 0x00, 0x00, 
  0x00, 0x00, 0x00, 0x03, 0xff, 0xff, 0xef, 0xff, 0xf8, 0x00, 0x00, 0x00, 0x00, 0x00, 0x00, 0x00, 
  0x00, 0x00, 0x00, 0x03, 0x81, 0xf7, 0xff, 0xff, 0xbf, 0xff, 0x80, 0x00, 0x00, 0x00, 0x00, 0x00, 
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  0x00, 0x00, 0x00, 0x00, 0x00, 0x00, 0x0f, 0x80, 0x00, 0x00, 0x00, 0x00, 0x00, 0x00, 0x00, 0x00
};
// '0005', 128x32px
const unsigned char myBitmap4 [] PROGMEM = {
  0x00, 0x00, 0x00, 0x03, 0xff, 0xff, 0xff, 0xc0, 0x00, 0x00, 0x00, 0x00, 0x00, 0x00, 0x00, 0x00, 
  0x00, 0x00, 0x00, 0x03, 0xff, 0xff, 0xef, 0xff, 0xf8, 0x00, 0x00, 0x00, 0x00, 0x00, 0x00, 0x00, 
  0x00, 0x00, 0x00, 0x03, 0x81, 0xf7, 0xff, 0xff, 0xbf, 0xff, 0x80, 0x00, 0x00, 0x00, 0x00, 0x00, 
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  0x00, 0x00, 0x00, 0x00, 0x00, 0x00, 0x0f, 0x80, 0x00, 0x00, 0x00, 0x00, 0x00, 0x00, 0x00, 0x00
};
// '0006', 128x32px
const unsigned char myBitmap5 [] PROGMEM = {
  0x00, 0x00, 0x00, 0x03, 0xff, 0xff, 0xff, 0xc0, 0x00, 0x00, 0x00, 0x00, 0x00, 0x00, 0x00, 0x00, 
  0x00, 0x00, 0x00, 0x03, 0xff, 0xff, 0xef, 0xff, 0xf8, 0x00, 0x00, 0x00, 0x00, 0x00, 0x00, 0x00, 
  0x00, 0x00, 0x00, 0x03, 0x81, 0xf7, 0xff, 0xff, 0xbf, 0xff, 0x80, 0x00, 0x00, 0x00, 0x00, 0x00, 
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  0x00, 0x00, 0x00, 0x00, 0x00, 0x00, 0x0f, 0x80, 0x00, 0x00, 0x00, 0x00, 0x00, 0x00, 0x00, 0x00
};
// '0007', 128x32px
const unsigned char myBitmap6 [] PROGMEM = {
  0x00, 0x00, 0x00, 0x03, 0xff, 0xff, 0xff, 0xc0, 0x00, 0x00, 0x00, 0x00, 0x00, 0x00, 0x00, 0x00, 
  0x00, 0x00, 0x00, 0x03, 0xff, 0xff, 0xef, 0xff, 0xf8, 0x00, 0x00, 0x00, 0x00, 0x00, 0x00, 0x00, 
  0x00, 0x00, 0x00, 0x03, 0x81, 0xf7, 0xff, 0xff, 0xbf, 0xff, 0x80, 0x00, 0x00, 0x00, 0x00, 0x00, 
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  0x00, 0x00, 0x00, 0x00, 0x00, 0x00, 0x0f, 0x80, 0x00, 0x00, 0x00, 0x00, 0x00, 0x00, 0x00, 0x00
};
// '0008', 128x32px
const unsigned char myBitmap7 [] PROGMEM = {
  0x00, 0x00, 0x00, 0x03, 0xff, 0xff, 0xff, 0xc0, 0x00, 0x00, 0x00, 0x00, 0x00, 0x00, 0x00, 0x00, 
  0x00, 0x00, 0x00, 0x03, 0xff, 0xff, 0xef, 0xff, 0xf8, 0x00, 0x00, 0x00, 0x00, 0x00, 0x00, 0x00, 
  0x00, 0x00, 0x00, 0x03, 0x81, 0xf7, 0xff, 0xff, 0xbf, 0xff, 0x80, 0x00, 0x00, 0x00, 0x00, 0x00, 
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  0x00, 0x00, 0x00, 0x00, 0x00, 0x00, 0x0f, 0x80, 0x00, 0x00, 0x00, 0x00, 0x00, 0x00, 0x00, 0x00
};

int hall = A0;                            // Declaration on which hall sensor1 pin is located sensor
int hall2 = A1;                           // Declaration on which hall sensor2 pin is located sensor
int led = LED_BUILTIN;                    // Led builtin pin 13
int state;                                // State of hall effect sensor
int state2;                               // State of second hall effect sensor
int goal_1 = 0;                             // The goal is for the counter1. Initialized
int goal_2 = 0;                             // The goal is for the counter2. Initialized
int maxGoal = 5;                           // Maximum goals. When the counter reaches 5 goals it returns to the initial value 0

void setup(){
  display.begin(SSD1306_SWITCHCAPVCC, 0x3C); // Display begin function
  Serial.begin (9600);                       // Function for serial monitor,  while (!Serial) {} // wait for serial port to connect. Needed for native USB (Arduino Leonardo)                                                                                                        
  pinMode (hall, INPUT);                     // Set input pins as input
  pinMode (hall2, INPUT);
  pinMode (led, OUTPUT);                      // Set led pin as output
  pinMode (12, OUTPUT);                       // Pin 12 is power source for second hall effect sensor, hall effect sensor maximum current is 8mA
  digitalWrite (12, HIGH);                     // Enable second hall effect sensor
}

 bool action = false;                        // Action for animation                                
 
void loop() {
  display.display();
  display.clearDisplay();                     // Clears display

  printResult();                          // Called function for print on oled 128x32

state = analogRead (hall);               // Reading analog values from hall effect sensor, values from 1023 to 0
state2 = analogRead (hall2);

if (state < 250)                         // Check for value of sensor, if it is less than 250 than add goal
 {
 goal_1++;                                // Add 1 goal
 digitalWrite (led, HIGH);
 Serial.println ("\nguests ");              // Print guests on serial monitor
 Serial.print (goal_1);
 delay (700);
 animation();
 guest();

 } 
 else if (state > 500)                   // Turning off led when value of sensor is higher than 500
 {
 digitalWrite (led, LOW); 
 }

if (state2 < 250){
 goal_2++;
 Serial.println ("\nhome ");            // Print guests on serial monitor
 Serial.print (goal_2);
 delay (700);
 animation();                             // Called goal animation function
 home1();                                 // Called home function for "Goal for the home team" - look line in code 363

}

else if (state2 > 500 ){
 
}
if (goal_1 >= maxGoal || goal_2 >= maxGoal){      // If goal_index is greater or equal to maximum goals than reset goals
  finalResult();
  goal_1 = 0;                                      // Resets goal to values
  goal_2 = 0;
}

}

void finalResult (){
  if(goal_1 >= maxGoal){                            // If goal_index is greater or equal to maximum goals than print The guest team won
   display.setCursor(0,0);             
   display.println("The guest team won");
  }
  if(goal_2 >= maxGoal){                            // If goal_index is greater or equal to maximum goals than print The home team won
    display.setCursor(0,0);             
    display.println("The home team won");
  }

 display.display(); 
 delay(3000);
}

void printResult(){

 display.setTextSize(1);            
 display.setTextColor(WHITE); 
        
 display.setCursor(10,0);             
 display.println("Guest ");
 display.setCursor(50,0);             
 display.print(goal_1);

 display.setCursor(70, 0);
 display.println("Home ");
 display.setCursor(120,0);             
 display.print(goal_2);
 display.display(); 
 delay(20);
}

void home1 (){
  display.setTextSize(1);
  display.setTextColor(SSD1306_WHITE);
  display.setCursor(10, 0);
  display.println(F("Goal for the home team"));
  display.display(); 
  delay(2000);
  display.clearDisplay();
}

void guest(){
  display.setTextSize(1);
  display.setTextColor(SSD1306_WHITE);
  display.setCursor(10, 0);
  display.println(F("Goal for the guests team"));
  display.display(); 
  delay(2000);
  display.clearDisplay();
}

void animation(){

  display.clearDisplay(); //for Clearing the display
  display.drawBitmap(0, 0, myBitmap1, 128, 32, WHITE); 
  display.display();
  delay(100);

  display.clearDisplay(); //for Clearing the display
  display.drawBitmap(0, 0, myBitmap2, 128, 32, WHITE); 
  display.display();
  delay(100);

  display.clearDisplay(); //for Clearing the display
  display.drawBitmap(0, 0, myBitmap3, 128, 32, WHITE);
  display.display();
  delay(100);
    
  display.clearDisplay(); //for Clearing the display
  display.drawBitmap(0, 0, myBitmap4, 128, 32, WHITE); 
  display.display();
  delay(100);
    
  display.clearDisplay(); //for Clearing the display
  display.drawBitmap(0, 0, myBitmap5, 128, 32, WHITE); 
  display.display();
  delay(100);
 
  display.clearDisplay(); //for Clearing the display
  display.drawBitmap(0, 0, myBitmap6, 128, 32, WHITE); 
  display.display();
  delay(100);

  display.clearDisplay(); //for Clearing the display
  display.drawBitmap(0, 0, myBitmap7, 128, 32, WHITE); 
  display.display();
  delay(1000);

display.display();
display.clearDisplay();

  action = false;

}
